## config/west.yml
```yaml
manifest:
  remotes:
    - name: zmkfirmware
      url-base: https://github.com/ufan
  projects:
    - name: zmk
      remote: zmkfirmware
      revision: support
      import: app/west.yml
  self:
    path: config
```
